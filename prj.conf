## CMakeLists.txt
```
# SPDX-License-Identifier: Apache-2.0

cmake_minimum_required(VERSION 3.13.1)
include($ENV{ZEPHYR_BASE}/cmake/app/boilerplate.cmake NO_POLICY_SCOPE)
project(atividade_2)

list(APPEND HEADERS 
    "${PROJECT_SOURCE_DIR}/include"
    "${PROJECT_SOURCE_DIR}/include/setup"
    "${PROJECT_SOURCE_DIR}/include/input"
    "${PROJECT_SOURCE_DIR}/include/es_button"
    )
    
list(APPEND SOURCES
    "${PROJECT_SOURCE_DIR}/src/main.c"
    "${PROJECT_SOURCE_DIR}/src/input.c"
    "${PROJECT_SOURCE_DIR}/src/es_button.c"
)
include_directories(${HEADERS})
target_sources(app PRIVATE ${SOURCES})
```

## prj.conf
```kconfig
CONFIG_PRINTK=y
CONFIG_GPIO=y
CONFIG_PWM=y
CONFIG_LOG=y
CONFIG_PWM_LOG_LEVEL_DBG=y
```

## src/main.c
```c
/*
 * Copyright (c) 2016 Intel Corporation
 *
 * SPDX-License-Identifier: Apache-2.0
 */


#include <zephyr.h>
#include <sys/util.h>
#include <sys/printk.h>
#include <device.h>
#include <drivers/pwm.h>
#include <drivers/gpio.h>


#include "es_button.h"
#include "setup.h"
#include "input.h"


// Definindo o Semáforo
K_SEM_DEFINE(data_sem, 1, 1);

// Definindo Fila de Mensagem 
K_MSGQ_DEFINE(my_msgq, sizeof(u32_t), 10, 4);

// --------------------------------------- //
enum { READING, WRITING, NONE} state = NONE;
typedef enum {SENSING, ALERT} event_t;

event_t current_event = SENSING;

es_button_t button0 = {0};

u8_t button0_pressed = 0;
u8_t data = 0;
u32_t val = 0;
struct device *pwm_dev;
input_t sensor1;

void state_machine_action()
{
    switch (state) {
        case READING:
            input_read(&sensor1, &val);
            printk("Realizando a aferição normalmente\n");
            break;
        case WRITING:
            input_read(&sensor1, &val);
            printk("Valor transferido para central: %d.\n", val);
            break;
        case NONE:
            printk("Em espera\n");
    }
}

void state_machine(event_t event)
{
    switch (state) 
    {
        case WRITING: 
        {
            if(event == ALERT) {
	        state = READING;
	} else if (event == SENSING) {
            state = WRITING;}
    	} break;
	case READING: {
            if(event == ALERT) {
	        state = WRITING;
	} else if (event == SENSING) {
            state = READING;}
    	} break;
    case NONE: {
        if(event == ALERT) {
            state = WRITING;
        } else if (event == SENSING) {
            state = NONE; }
        }
	default:
	    state = READING;
	}
	state_machine_action();
}

void button0_callback(struct device *gpiob, struct gpio_callback *cb, u32_t pins)
{
    printk("Button 0 pressed!\n");
    button0_pressed = 1;
    printk("Button 0 Value [%d]\n", button0_pressed);
}

void sensor(input_t *sensor, u32_t pin, char *port){
    int e = input_open(sensor, port);
    if(e){
        printk("Alerta: Sensor para o PIN%d não inicializado.\n", pin);
        return;
    }
    input_configure(sensor, pin, GPIO_DIR_IN | SW_GPIO_FLAGS);
    printk("Sensor em PIN%d inicializado.\n", pin);
}

void main(void)
{
// ---------------------------------------------
    printk("Inicializando o Botão\n");
    button_create(&button0, BUTTON_DEVICE, BUTTON_PIN0, button0_callback);
    printk("Botão OK\n");
// ---------------------------------------------
   // BEGIN PWM
    printk("Inicializando o device PWM\n");

    pwm_dev = device_get_binding(PWM_DRIVER);

    if (!pwm_dev) 
    {
        printk("Cannot find %s!\n", PWM_DRIVER);
    }

    else
    {
        printk("PWM device inicializado\n");
    }
    // END PWM
// ---------------------------------------------
    // SENSOR INITIALIZATION
    //input_t sensor1;
    sensor(&sensor1, XL2_PIN, XL2_PORT);
    // END SENSOR
// ---------------------------------------------
    printk("Hello Main Thread\n");

    while(1)
    {
        k_sleep(K_SECONDS(1));
    }
}

// ------------------------------------------------------------
// ------------------------------------------------------------
//  Thread de leitura
void readThread(void)
{
    printk("Hello Read Thread\n");
    
    while(1)
    {	
	    //u32_t val = 0U;
        k_sleep(K_MSEC(SLEEP_TIME));
        k_sem_take(&data_sem, K_FOREVER);

        // ÁREA RESERVADA
	
	current_event = SENSING;
    //printk("STATE - [%d] | CURRENT EVENT - [%d] - READ THREAD\n", state, current_event);
	state_machine(current_event);

	//SAINDO DA ÁREA RESERVADA

        //data += 1; 
        k_sem_give(&data_sem);	
    }
	
}
// ------------------------------------------------------------
// ------------------------------------------------------------

// THREAD DOS BOTÕES - Ao pressionar o botão LED PWM ativado
void buttonPWMThread(void)
{
        printk("Hello button Thread\n");
        u8_t step = 1;
        u8_t counter = 0;

        //PWM
	

        while(1)
        {   
            k_sleep(K_MSEC(PWM_TIME));

            if(button0_pressed == 1)    
            {
                printk("Value of BUTTON 0 [%d]\n", button0_pressed);
		        current_event = ALERT;
                //printk("STATE - [%d] | CURRENT EVENT - [%d] - BUTTON THREAD\n", state, current_event);
		        state_machine(current_event);

                if (pwm_pin_set_usec(pwm_dev, PWM_CHANNEL, PERIOD, (PERIOD / 50) * step)) 
                {
                    printk("pwm pin set fails\n");
                }

                step++;
                if (step == 50) 
                {
                    step = 1;
                    counter += 1;
                }

                if (counter == 2)
                {
                    button0_pressed = 0;
                    counter = 0;
                    pwm_pin_set_usec(pwm_dev, PWM_CHANNEL, PERIOD, (PERIOD / 50) * 1);
                }
            }
        }
}

// ------------------------------------------------------------
// ------------------------------------------------------------

// THREAD de Sincronização
void printThread(void)
{
    printk("Hello Print Thread\n");
    u8_t test = 0;

    while(1)
    {
        k_sleep(K_MSEC(SLEEP_TIME));
        k_sem_take(&data_sem, K_FOREVER);
	// ÁREA RESERVADA
	
	current_event = SENSING;
    //printk("STATE - [%d] | CURRENT EVENT - [%d] - PRINT THREAD\n", state, current_event);
	state_machine(current_event);

        test = data;
        printk("Value of data [%d]\n", test);

	//SAINDO DA ÁREA RESERVADA
        k_sem_give(&data_sem);	
    }
}

// ------------------------------------------------------------
// ------------------------------------------------------------

K_THREAD_DEFINE(readid, STACKSIZE, readThread, NULL, NULL, NULL,
		PRIORITY, 0, K_NO_WAIT);
K_THREAD_DEFINE(printid, STACKSIZE, printThread, NULL, NULL, NULL,
		PRIORITY, 0, K_NO_WAIT);

K_THREAD_DEFINE(buttonid, STACKSIZE, buttonPWMThread, NULL, NULL, NULL,
		PRIORITY, 0, K_NO_WAIT);

/*
K_THREAD_DEFINE(machineid, STACKSIZE, machineThread, NULL, NULL, NULL,
		PRIORITY, 0, K_NO_WAIT);
*/
```

## include/es_button.h
```c
#ifndef _ES_BUTTON_H_
#define _ES_BUTTON_H_

#include <device.h>
#include <drivers/gpio.h>
#include <zephyr/types.h>

typedef struct button_s es_button_t;

struct button_s {
    struct device* dev;
    struct gpio_callback gpio_cb;
    u32_t pin;
};

int button_create(es_button_t* button, const char* dev_name, u32_t pin,
                     gpio_callback_handler_t callback);

#endif /*_ES_BUTTON_H_*/
```

## include/input.h
```c
#ifndef _INPUT_H_
#define _INPUT_H_

#include <sys/printk.h>
#include <device.h>
#include <gpio.h>

typedef struct input input_t;

struct input {
    struct device *device;
    struct gpio_callback gpio_callback;
    char *dev_label;
    u32_t pin;
};


/**
 * Essa função tem como objetivo iniciar o device do driver
 * de entrada.
 * @param in
 *
 * @return
 */
int input_open(input_t *in, char *dev_label);

/**
 * Essa função tem como objetivo configurar o pino de entrada.
 *
 * @param in
 * @param pin
 * @param flags
 * @param cb
 *
 * @return
 */
int input_configure(input_t *in, u32_t pin, int flags);

/**
 * Essa função tem como objetivo fazer uma leitura do pino
 * de entrada.
 * @param in
 * @param state
 *
 * @return
 */
int input_read(input_t *in, u32_t *state);

#endif
```

## include/output.h
```c
#ifndef _OUTPUT_H_
#define _OUTPUT_H_

#include <device.h>
#include <gpio.h>


struct output {
    struct device *device;
    char *dev_label;
    u32_t pin;
    u8_t state;
};

typedef struct output output_t;

/** 
 * Essa função tem como objetivo iniciar o driver output,
 * ou seja, iniciar o device. 
 * @param out 
 *
 * @return 
 */
int output_open(output_t *out, char *dev_label);

/** 
 * Essa função tem como objetivo configurar o pino de saída
 * de acordo com suas flags.
 * @param out 
 * @param pin 
 * @param flags 
 *
 * @return 
 */
int output_configure(output_t *out, u32_t pin, int flags);

/** 
 * Essa função tem como objetivo setar o estado do pino de
 * saída para algum valor.
 * @param out 
 * @param value 
 *
 * @return 
 */
int output_set(output_t *out, u8_t value);

/** 
 * Essa função tem como objetivo inverter o estado do pino de
 * saída.
 * @param out 
 *
 * @return 
 */
int output_pressed(output_t *out);

/** 
 * Essa função tem como objetivo inicializar leds
 * @param led
 * @param pin
 * @param port
 * @param state
 *
 * @return 
 */

void led(output_t *led, u32_t pin, char *port, u8_t state);

#endif
```

## include/sensor_dht.h
```c
#ifndef _SENSOR_DHT_H_
#define _SENSOR_DHT_H_

#include <device.h>
#include <gpio.h>
#include <sensor.h>

/* Get temperature values from DHT sensor*/
int on_get_temperature(int id);

/* Get relative humidity values from DHT sensor*/
int on_get_humidity(int id);

/* Plot Datatime */
static const char *now_str(void);
```

## include/setup.h
```c
// DEFINIÇÕES DOS COMPONENTES DO PROJETO //

// Definindo o pino do Botão
#define BUTTON_DEVICE DT_ALIAS_SW0_GPIOS_CONTROLLER
#define BUTTON_PIN0 DT_ALIAS_SW0_GPIOS_PIN

#define XL2_PORT DT_ALIAS_SW2_GPIOS_CONTROLLER	//pin P0.01 / XL2
#define XL2_PIN DT_ALIAS_SW2_GPIOS_PIN  		//pin P0.01 / XL2 AJUSTAR CASO NECESSITE COLOCAR O 'S'

// Definindo tempo de espera
#define SLEEP_TIME 500

// Definindo tempo do PWM
#define PWM_TIME 100

// Tamanho da STACK
#define STACKSIZE 1024

// Prioridade das Threads
#define PRIORITY 0

// PWM

//#if defined(DT_ALIAS_PWM_LED0_PWMS_CONTROLLER) && defined(DT_ALIAS_PWM_LED0_PWMS_CHANNEL)
/* get the defines from dt (based on alias 'pwm-led0') */
#define PWM_DRIVER	DT_ALIAS_PWM_LED0_PWMS_CONTROLLER
#define PWM_CHANNEL	DT_ALIAS_PWM_LED0_PWMS_CHANNEL
//#else
//#error "Choose supported PWM driver"
//#endif

#define PERIOD (USEC_PER_SEC / 50U)

// Flags de interrupções do GPIO
#define INTERRUPT GPIO_INT
#define FALLING_EDGE (GPIO_INT_EDGE | GPIO_INT_ACTIVE_LOW)
#define DEBOUNCE GPIO_INT_DEBOUNCE
#define PULL_UP GPIO_PUD_PULL_UP
#define SW_GPIO_FLAGS (INTERRUPT | FALLING_EDGE | DEBOUNCE | PULL_UP)
```

## src/es_button.c
```c
#include "es_button.h"

int button_create(es_button_t* button, const char* dev_name, u32_t pin,
                     gpio_callback_handler_t callback)
{
    button->dev = device_get_binding(dev_name);
    button->pin = pin;
    gpio_pin_configure(button->dev, pin,
                       GPIO_DIR_IN | GPIO_PUD_PULL_UP | GPIO_INT | GPIO_INT_DEBOUNCE
                           | GPIO_INT_EDGE | GPIO_INT_ACTIVE_HIGH);
    gpio_init_callback(&button->gpio_cb, callback, BIT(pin));
    gpio_add_callback(button->dev, &button->gpio_cb);
    gpio_pin_enable_callback(button->dev, pin);
    return 0;
}
```

## src/input.c
```c
#include <gpio.h>

//#include "setup.h"
#include "input.h"

int input_open(input_t *in, char *dev_label) {
    in->dev_label = dev_label;
    in->device = device_get_binding(in->dev_label);

    if(in->device == NULL) {
      printk("[INPUT] Error: Device not found or cannot be used.\n");
      return 1;
    }
    return 0;
}

int input_configure(input_t *in, u32_t pin, int flags) {
    in->pin = pin;
    gpio_pin_configure(in->device, in->pin, flags);
    return 0;
}

int input_read(input_t *in, u32_t *state) {
    gpio_pin_read(in->device, in->pin, state);
    return 0;
}
```

## src/output.c
```c
#include "output.h"
#include <gpio.h>
#include <drivers/pwm.h>

#include "setup.h"

int output_open(output_t *out, char *dev_label) {
    out->dev_label = dev_label;
    out->device = device_get_binding(out->dev_label);
    //printk("output_open done\n");
     if(!out->device){
        printk("Função: output_open (arquivo: ouput.c).\nFalha na atribução do out->device.\n");
        return 1;
    }
    return 0;
}

int output_configure(output_t *out, u32_t pin, int flags) {
    out->pin = pin;
    gpio_pin_configure(out->device, out->pin, flags);
    //printk("output_configure done\n");
    return 0;
}

int output_set(output_t *out, u8_t value) {
    out->state = value;
    gpio_pin_write(out->device, out->pin, out->state);
    //printk("output_set done\n");
    return 0;
}

int output_pressed(output_t *out) {
    if(out->state == 1) {
        out->state = 0;
        gpio_pin_write(out->device, out->pin, out->state);
    } else {
        out->state = 1;
        gpio_pin_write(out->device, out->pin, out->state);
    }
    //printk("output_pressed done\n");
    return 0;
}


// Inicializador Led
void led(output_t *led, u32_t pin, char *port, u8_t state){
    int e = output_open(led, port);
    if(e){
        printk("Alerta: Led para o PIN%d não inicializado.\n", pin);
        return;
    }
    output_configure(led, pin, GPIO_DIR_OUT);
    output_set(led, state);
    printk("Led em PIN%d inicializado.\n", pin);
}
```

## src/sensor_dht.c
```c
#include "sensor_dht.h"
#include <sensor.h>
#include <gpio.h>

/* Get temperature values from DHT sensor*/
int on_get_temperature(void)
{
	struct sensor_value temp;

	sensor_channel_get(dev, SENSOR_CHAN_AMBIENT_TEMP, &temp);
	temperature = temp.val1;
	LOG_INF("Temperature value: %d \n", temperature);

	return 1;
}

/* Get relative humidity values from DHT sensor*/
int on_get_humidity(void)
{
	struct sensor_value humidity;

	sensor_channel_get(dev, SENSOR_CHAN_HUMIDITY, &humidity);
	relative_humidity = humidity.val1;
	LOG_INF("Relative humidity value: %d \n", relative_humidity);
	
	return 1;
}

/* Plot Datatime */
static const char *now_str(void)
{
	static char buf[16]; /* ...HH:MM:SS.MMM */
	u32_t now = k_uptime_get_32();
	unsigned int ms = now % MSEC_PER_SEC;
	unsigned int s;
	unsigned int min;
	unsigned int h;

	now /= MSEC_PER_SEC;
	s = now % 60U;
	now /= 60U;
	min = now % 60U;
	now /= 60U;
	h = now;

	snprintf(buf, sizeof(buf), "%u:%02u:%02u.%03u",
		 h, min, s, ms);
	return buf;
}
```
